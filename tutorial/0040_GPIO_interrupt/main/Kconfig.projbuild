## tutorial/0040_GPIO_interrupt/main/Kconfig.projbuild
```kconfig
menu "Example Configuration"

config OUTPUT_GPIO
    int "Output GPIO number"
	range 0 34
	default 5
	help
		GPIO number (IOxx) to LED on and off.

		Some GPIOs are used for other purposes (flash connections, etc.) and cannot be used to blink.

		GPIOs 35-39 are input-only so cannot be used as outputs.

endmenu
```
